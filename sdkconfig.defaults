## sdkconfig.defaults
```kconfig
CONFIG_ESP_ALLOW_MULTIPLE_DEFINITIONS=y
CONFIG_COMPILER_CXX_EXCEPTIONS=n

CONFIG_ESP_TASK_WDT=n
CONFIG_ESP_INT_WDT=n
CONFIG_ESP_SYSTEM_WDT=n

# Debug options
CONFIG_ESP32_APPTRACE_ENABLE=y
CONFIG_ESP32_APPTRACE_LOCK_ENABLE=y
CONFIG_FREERTOS_GENERATE_RUN_TIME_STATS=y
CONFIG_ESP_DEBUG_STUBS_ENABLE=y
CONFIG_ESP_SYSTEM_CHECK_INT_LEVEL_4=y

CONFIG_ESP32_DEBUG_STUBS_ENABLE=y

# Additional debug settings to improve reliability
CONFIG_FREERTOS_WATCHPOINT_END_OF_STACK=y
CONFIG_ESP_SYSTEM_SINGLE_CORE_MODE=y
CONFIG_ESP_CACHE_FLASH_IGNORE_CORE_DUMP=n

CONFIG_ESP_SYSTEM_GDBSTUB_RUNTIME=y






## Arduino
CONFIG_ARDUINO=y
CONFIG_ARDUINO_RUN_CORE1=y
CONFIG_ARDUINO_ESP32_USE_SERIAL1=y
CONFIG_ARDUINO_ESP32_USE_SERIAL2=y
CONFIG_ARDUINO_ESP32_USE_SERIAL3=y
CONFIG_ARDUINO_ESP32_USE_SERIAL4=y
CONFIG_ARDUINO_ESP32_USE_SERIAL5=y
CONFIG_ARDUINO_ESP32_USE_SERIAL6=y
CONFIG_COMPILER_CXX_EXCEPTIONS=y



## WLAN
#CONFIG_ESP_WIFI_SSID="YOUR_SSID"          # replace with your Wi-Fi SSID
#CONFIG_ESP_WIFI_PASSWORD="YOUR_PASSWORD"  # replace with your Wi-Fi password
#CONFIG_MICRO_ROS_AGENT_IP="192.168.1.100" # IP address of micro-ROS agent (PC)


## MICRO-ROS
CONFIG_MICRO_ROS_ESP_NETIF_WLAN=y         # Use Wi-Fi network interface for micro-ROS
CONFIG_MICRO_ROS_AGENT_PORT="8888"        # UDP port of agent (default 8888)
```
